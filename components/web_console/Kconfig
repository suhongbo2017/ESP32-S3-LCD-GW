## components/web_console/Kconfig
```kconfig
# web_console 组件配置（menuconfig: Component config -> web_console）
menu "web_console（Web 控制台）"

config WEB_CONSOLE_PORT
    int "HTTP 端口"
    default 80

config WEB_CONSOLE_MDNS_ENABLE
    bool "启用 mDNS（可用 http://<主机名>.local 访问）"
    default y
    help
        依赖客户端与路由器支持多播；Windows10/11、macOS、iOS、Linux(Avahi) 一般可用。
        不支持时仍可用 IP 访问。

config WEB_CONSOLE_MDNS_HOSTNAME
    string "mDNS 主机名"
    default "esp32gw"
    help
        访问地址：http://<主机名>.local/

endmenu
```
